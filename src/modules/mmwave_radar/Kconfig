## src/modules/mmwave_radar/Kconfig
```kconfig
menuconfig MODULES_MMWAVE_RADAR
    bool "mmwave_radar"
    default n
    ---help---
        Enable support for mmwave_radar
```

## src/modules/rocket_avoidance/Kconfig
```kconfig
menuconfig MODULES_ROCKET_AVOIDANCE
    bool "rocket_avoidance"
    default n
    ---help---
        Enable support for rocket_avoidance
```

## src/modules/rocket_guidance/Kconfig
```kconfig
menuconfig MODULES_ROCKET_GUIDANCE
    bool "rocket_guidance"
    default n
    ---help---
        Enable support for rocket_guidance
```

## src/modules/rocket_mapper/Kconfig
```kconfig
menuconfig MODULES_ROCKET_MAPPER
    bool "rocket_mapper"
    default n
    ---help---
        Enable support for rocket_mapper
```

## src/modules/rocket_planner/Kconfig
```kconfig
menuconfig MODULES_ROCKET_PLANNER
    bool "rocket_planner"
    default n
    ---help---
        Enable support for rocket_planner
```

## src/modules/srm_manager/Kconfig
```kconfig
menuconfig MODULES_SRM_MANAGER
    bool "srm_manager"
    default n
    ---help---
        Enable support for srm_manager
```
